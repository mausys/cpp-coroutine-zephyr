## CMakeLists.txt
```
# SPDX-License-Identifier: Apache-2.0

cmake_minimum_required(VERSION 3.20.0)

find_package(Zephyr REQUIRED HINTS $ENV{ZEPHYR_BASE})
project(cosched)

target_sources(app PRIVATE src/main.cpp)
```

## sample.yaml
```
sample:
  description: c++ coroutine scheduler
  name: cosched
common:
  integration_platforms:
    - native_sim
  harness: console
```

## prj.conf
```kconfig
CONFIG_CPP=y
CONFIG_STD_CPP20=y
CONFIG_CPP_EXCEPTIONS=y
CONFIG_REQUIRES_FULL_LIBCPP=y

CONFIG_POSIX_API=y
CONFIG_SHELL=y
```

## src/main.cpp
```c
#include <iostream>

#include "cosched.hpp"

using namespace cosched;

class Context {
  public:
    int  cnt = 0;
};

Task<Context> grandchild900(Context& )
{
  std::cout << "grandchild900 started; sleep" << std::endl;
  co_await AwaitSleep{K_MSEC(900)};
  std::cout << "grandchild900 woke up; return" << std::endl;
  co_return;
}

Task<Context> grandchild800(Context&)
{
  std::cout << "grandchild800 started; sleep" << std::endl;
  co_await AwaitSleep{K_MSEC(800)};
  std::cout << "grandchild800 woke up; return" << std::endl;
  co_return;
}

Task<Context> grandchild700(Context&)
{
  std::cout << "grandchild700 started; sleep" << std::endl;
  co_await AwaitSleep{K_MSEC(700)};
  std::cout << "grandchild700 woke up; return" << std::endl;
  co_return;
}
Task<Context> grandchild600(Context&)
{
  std::cout << "grandchild600 started; sleep" << std::endl;
  co_await AwaitSleep{K_MSEC(600)};
  std::cout << "grandchild600 woke up; return" << std::endl;
  co_return;
}
Task<Context> grandchild500(Context&)
{
  std::cout << "grandchild500 started; sleep" << std::endl;
  co_await AwaitSleep{K_MSEC(500)};
  std::cout << "grandchild500 woke up; return" << std::endl;
  co_return;
}
Task<Context> grandchild400(Context&)
{
  std::cout << "grandchild400 started; sleep" << std::endl;
  co_await AwaitSleep{K_MSEC(400)};
  std::cout << "grandchild400 woke up; return" << std::endl;
  co_return;
}
Task<Context> grandchild300(Context&)
{
  std::cout << "grandchild300 started; sleep" << std::endl;
  co_await AwaitSleep{K_MSEC(300)};
  std::cout << "grandchild300 woke up; return" << std::endl;
  co_return;
}
Task<Context> grandchild200(Context&)
{
  std::cout << "grandchild200 started; sleep" << std::endl;
  co_await AwaitSleep{K_MSEC(200)};
  std::cout << "grandchild200 woke up; return" << std::endl;
  co_return;
}

Task<Context> grandchild100(Context&)
{
  std::cout << "grandchild100 started; sleep" << std::endl;
  co_await AwaitSleep{K_MSEC(100)};
  std::cout << "grandchild100 woke up; return" << std::endl;
  co_return;
}


Task<Context> grandchild0(Context&)
{
  std::cout << "grandchild0 started; sleep" << std::endl;
  co_await AwaitSleep{K_MSEC(0)};
  std::cout << "grandchild0 woke up; return" << std::endl;
  co_return;
}

Task<Context> grandchild(Context&)
{
  std::cout << "grandchild started; sleep" << std::endl;
  co_await AwaitSleep{K_MSEC(300)};
  std::cout << "grandchild woke up; return" << std::endl;
  co_await AwaitSpawn{grandchild900, NULL};
  co_await AwaitSpawn{grandchild0, NULL};
  co_await AwaitSpawn{grandchild800, NULL};
  co_await AwaitSpawn{grandchild100, NULL};
  co_await AwaitSpawn{grandchild700, NULL};
  co_await AwaitSpawn{grandchild200, NULL};
  co_await AwaitSpawn{grandchild600, NULL};
  co_await AwaitSpawn{grandchild300, NULL};
  co_await AwaitSpawn{grandchild500, NULL};

  co_return;
}



Task<Context> child1(Context&)
{
  std::cout << "child1 started; sleep" << std::endl;
  co_await AwaitSleep{K_MSEC(100)};
  std::cout << "child1 woke up; return" << std::endl;
  co_return;
}


Task<Context> child2(Context&)
{
  std::cout << "child2 started; sleep" << std::endl;
  co_await AwaitSleep{K_MSEC(10)};
  std::cout << "child2 woke up; spawn grandchild" << std::endl;
  co_await AwaitSpawn{grandchild, NULL};
  co_return;
}


Task<Context> comain(Context&)
{
  std::cout << "main start" << std::endl;

  TaskId child1id, child2id;
  std::cout << "main started; spawn child1" << std::endl;
  co_await AwaitSpawn{child1, &child1id};
  std::cout << "main child1 spawned; spawn child2" << std::endl;
  co_await AwaitSpawn{child2, &child2id};
  std::cout << "main child2 spawned; sleep" << std::endl;
  co_await AwaitSleep{K_MSEC(20)};
  std::cout << "main woke up; spawn child2" << std::endl;
  co_await AwaitSpawn{child2, &child2id};
  std::cout << "main spawned child2; join child1" << std::endl;
  co_await AwaitJoin{child1id};
  std::cout << "main joined child1; join child2" << std::endl;
  co_await AwaitJoin{child2id};
  std::cout << "main joined child2; return" << std::endl;
}

int main()
{
  {
    Context ctx;
  Scheduler<Context> sched(comain, ctx);
  for  (int i = 0; !sched.done(); i++) {
    //cout << "poll {}", i);
    sched.Poll();
    k_sleep(K_MSEC(1));
  }
  }

}
```

## src/cosched.hpp
```c
#pragma once

#include <cassert>
#include <climits>
#include <utility>
#include <variant>
#include <exception>
#include <vector>
#include <queue>
#include <coroutine>

#include <zephyr/kernel.h>

namespace cosched {

template<typename T>
struct Task;

using  TimePoint =  k_timepoint_t;
using TimeOut = k_timeout_t;
using UId = unsigned;
using Index = size_t;

const UId kUIdInvalid = UINT_MAX;
const Index kIndexInvalid = ~(Index)0;

struct TaskId {
  // index of scheduler task vector
  Index index;
  // since indices are recycled uid as additional check is needed,
  UId uid;

  bool operator==(const TaskId& rhs) const = default;
};

const TaskId TaskIdInvalid = {
    .index = kIndexInvalid,
    .uid = kUIdInvalid,
};


// for wait queue
struct TimeoutTask{
  TimePoint timepoint;
  TaskId tid;
  auto operator<=>(const TimeoutTask& rhs) const {
    return sys_timepoint_cmp (timepoint, rhs.timepoint);
  }
};


TimePoint CalcTimePoint(TimeOut timeout) {
  return sys_timepoint_calc(timeout);
}


struct AwaitDataSleep {
  TimeOut timeout;
};


template <typename T>
struct AwaitDataSpawn {
  using start_fn = Task<T> (*)(T&);
  start_fn start;
  TaskId *tid;

};

struct AwaitDataJoin {
  TaskId tid;
};




struct AwaitBase {
  bool await_ready() noexcept { return false; }
  void await_suspend (std::coroutine_handle<>) noexcept {}
  void await_resume() noexcept {}
};

struct AwaitSleep : AwaitBase
{
  explicit AwaitSleep(TimeOut timeout) : data{timeout} {}
  AwaitDataSleep data;
};

template <typename T>
struct AwaitSpawn : AwaitBase {
  using start_fn = Task<T> (*)(T&);
  AwaitSpawn(start_fn start, TaskId *tid) : data{start, tid} {}
  AwaitDataSpawn<T> data;
};


struct AwaitJoin : AwaitBase {
  explicit AwaitJoin(TaskId tid) : data {tid} {}
  AwaitDataJoin data;
};

template<typename T>
using AwaitData = std::variant<std::monostate, AwaitDataSleep, AwaitDataSpawn<T>, AwaitDataJoin>;


template<typename T>
struct Task
{
  struct promise_type
  {
    using coro_handle = std::coroutine_handle<promise_type>;

    AwaitData<T> data;

    std::exception_ptr exception_ = nullptr;

    auto get_return_object() { return coro_handle::from_promise(*this); }

    auto initial_suspend() noexcept {  return std::suspend_never(); }

    // suspend_always is needed so scheduler can handle it
    auto final_suspend() noexcept {
      data = std::monostate{};
      return std::suspend_always();
    }

    // copy await data for scheduler
    auto await_transform(struct AwaitSleep await) noexcept {
      assert(std::get_if<std::monostate>(&data));
      data = await.data;
      return await;
    };

    auto await_transform(AwaitSpawn<T> await) noexcept {
      assert(std::get_if<std::monostate>(&data));

      data = await.data;

      return await;
    };


    auto await_transform(AwaitJoin await) noexcept {
      assert(std::get_if<std::monostate>(&data));

      data = await.data;

      return await;
    };

    void return_void() {}

    void unhandled_exception() {
      exception_ = std::current_exception();
    }
  };

  Task(promise_type::coro_handle handle) : handle_(handle) {}


  Task(Task const&) = delete;
  Task& operator=(Task &task) = delete;

  Task(Task&& task) {
     // new task added to task vector
    assert(this->handle_ == nullptr);

    this->handle_ = std::exchange(task.handle_, nullptr);
    this->uid_ = task.uid_;
    this->parent_ = task.parent_;
  };

  Task& operator=(Task&& task)  {
    // recycling vector index, check old task
    assert(this->handle_ == nullptr);

    this->handle_ = std::exchange(task.handle_, nullptr);
    this->uid_ = task.uid_;
    this->parent_ = task.parent_;
    return *this;
  };

  void rethrow_exception() {
    std::exception_ptr exception = std::exchange(exception_, nullptr);

    if (exception)
      std::rethrow_exception(exception);

  }

  ~Task()
  {
    done();
  }


  bool done() {
    if (handle_ == nullptr)
      return true;

    if (handle_.done()) {
      //safe exception
      exception_ = handle_.promise().exception_;

      handle_.destroy();
      handle_ = nullptr;
      return true;
    }

    return false;
  }


  AwaitData<T> take_data() {
    return std::exchange(handle_.promise().data, std::monostate{});
  }


  bool resume()
  {
    ready_ = false;

    if (done())
      return false;

    handle_();

    return !done();
  }


  bool setReady() {
    bool tmp = ready_;
    ready_ = true;
    return tmp;
  }


  UId uid_ = kUIdInvalid;
  TaskId parent_ = TaskIdInvalid;

private:
  bool ready_ = false;
  std::exception_ptr exception_ = nullptr;
  promise_type::coro_handle handle_ = nullptr;
};

template <typename T>
class Scheduler {
  using start_fn = Task<T> (*)(T&);


public:
  Scheduler(start_fn start, T arg) : arg_{arg}, spawn_{start} {}

  void Poll() {
    // moves tasks from wait_ to ready_ queue, if timeout elapsed
    CheckWaitingTasks();

    if (spawn_.start) {
      start_fn start = spawn_.start;
      spawn_.start = nullptr;

      Task task = start(arg_);

      if (task.done()) {
        // task finished; no tid tell parent
        if (spawn_.tid)
          *spawn_.tid = TaskIdInvalid;
        task.rethrow_exception();
        return;
      }

      TaskId tid = AddTask(std::move(task));

      if (spawn_.tid) {
        // tell parent tid of child
        *spawn_.tid = tid;
        spawn_.tid = nullptr;
      }

      ProcessResult(tid);
    } else if (!ready_.empty()) {
      // process ready queue

      TaskId tid = ready_.front();
      ready_.pop();
      Task<T> *task = GetTask(tid);

      assert(task && !task->done());

      task->resume();

      ProcessResult(tid);
    }
  }
  bool done() {
    return wait_.empty() && ready_.empty() && !spawn_.start;
  }

private:

  Task<T>* GetTask(TaskId tid) {
    if (tid == TaskIdInvalid)
      return nullptr;

    Task<T> &task = tasks_[tid.index];

    return tid.uid == task.uid_ ? &task : nullptr;
  }

  void SetReady(TaskId tid) {
    Task<T> *task = GetTask(tid);
    if (!task)
      return;

    if (task->done())
      return;

    if (!task->setReady()) {
        // only push task to ready queue once
        ready_.push(tid);
    }
  }


  TaskId AddTask(Task<T> &&task)
  {
    task.uid_ = next_uid_++;

    unsigned index;
    if (!free_indices_.empty()) {
      // recycle index
      index = free_indices_.front();
      free_indices_.pop();

      tasks_[index] = std::move(task);
    } else {
      tasks_.push_back(std::move(task));
      index = tasks_.size() - 1;
    }
    return TaskId{index, task.uid_};
  }


  void CheckWaitingTasks()
  {

    for (;;) {
      if (wait_.empty())
        break;

      const TimeoutTask &task = wait_.top();

      if (!sys_timepoint_expired(task.timepoint))
        break;

      SetReady(task.tid);

      wait_.pop();
    }
  }

  void ProcessResult(TaskId tid) {
    Task<T> *task = GetTask(tid);

    assert(task);

    if (task->done()) {
      SetReady(task->parent_);
      tasks_[tid.index].uid_= kUIdInvalid;
      // recycle index
      free_indices_.push(tid.index);
      task->rethrow_exception();
      return;
    }

    AwaitData<T> await = task->take_data();

    if (std::get_if<std::monostate>(&await)) {
      SetReady(tid);
    } else if (const auto* data = std::get_if<AwaitDataSleep>(&await)) {
      TimePoint tp = CalcTimePoint(data->timeout);
      wait_.push(TimeoutTask{tp, tid});
    } else if (const auto* data = std::get_if<AwaitDataSpawn<T>>(&await)) {
      assert(spawn_.start == nullptr);
      spawn_.start = data->start;
      spawn_.tid = data->tid;

      if (spawn_.tid)
        *spawn_.tid = TaskIdInvalid;
      SetReady(tid);
    } else if (const auto* data = std::get_if<AwaitDataJoin>(&await)) {
      Task<T> *child = GetTask(data->tid);

      if (!child || child->done()) {
        // child already done
        SetReady(tid);
      } else {
        assert(child->parent_ == TaskIdInvalid);
        child->parent_ = tid;
      }
    }
  }
  T& arg_;

  // next_uid incremented everytime it is used
  unsigned next_uid_ = 0;

  // task requested spawn; spawn in next poll
  struct {
    start_fn start;
    TaskId *tid = nullptr;
  } spawn_;

  // all tasks
  std::vector<Task<T>> tasks_;

  // can be executed
  std::queue<TaskId> ready_;

  // sleeping tasks
  std::priority_queue<TimeoutTask, std::vector<TimeoutTask>, std::greater<TimeoutTask>> wait_;

  // for recycling tasks_indices
  std::queue<unsigned> free_indices_;
};


}
```
